## arch/arm/mach-sun6i/Kconfig
```kconfig
choice
	prompt "Allwinner Platform Type"
	depends on ARCH_SUN6I || ARCH_SUN7I
	default AW_PLATFORM_EVB

config AW_FPGA_V4_PLATFORM
       bool "FPGAv4 board"
       help
         Support for Allwinner's FPGAv4 board

config AW_FPGA_V7_PLATFORM
       bool "FPGAv7 board"
       help
         Support for Allwinner's FPGAv4 board

config AW_ASIC_EVB_PLATFORM
       bool "EVB board"
       help
         Support for Allwinner's EVB board

endchoice

config SUNXI_SYSFS
	bool "Allwinner SUNXI Sysfs"
    depends on ARCH_SUN6I
	help
	  Support /sys/class/sunxi for kernel.

config SUNXI_POWER_SCENE
	bool "support scene change notify"
    depends on SUNXI_SYSFS
	help
	  Support /sys/class/sunxi/power/scene for kernel.

config SUNXI_MEMORY_SIZE
	int "Memory Size(in MB) on sunxi Platform"
	default 2048
	depends on ARCH_SUN6I
	help
	Memory Size(in MB) on sunxi Platform

config SUNXI_MEMORY_RESERVED_SIZE
	int "reserved Memory size(in MB) for sunxi deve heap."
	default 168
	depends on ARCH_SUN6I
	help
	  Select reserved memory size for sunxi deve heap, the memory is used by deve.
	  Examples:
	  100 => reserve 100M bytes memory for deve heap.
	  230 => reserve 230M bytes memory for deve heap.
```

## drivers/gpu/ion/Kconfig
```kconfig
menuconfig ION
	tristate "Ion Memory Manager"
	select GENERIC_ALLOCATOR
	select DMA_SHARED_BUFFER
	help
	  Chose this option to enable the ION Memory Manager.

config ION_CARVEOUT
	bool "Carveout heap"
	depends on ARM
	help
	  Enable physical memory carveout and chunk heaps. Only supported on
	  ARM platforms.

config ION_SUNXI_CARVEOUT_SIZE
	int "memory size(in MB) for sunxi carveout ion heap."
	default 360
	depends on ION
	help
	  Select memory size for sunxi carveout ion heap, the memory is used by gpu.
	  Examples:
	  	     100 => reserve 100M bytes memory for carveout heap.
	  	     230 => reserve 230M bytes memory for carveout heap.
```

## drivers/net/wireless/rtl8188eu_4.2/Kconfig
```kconfig
config RTL8188EU_SW
	tristate "Realtek 8188E USB WiFi For Android4.2"
	depends on USB
	select WIRELESS_EXT
	select WEXT_PRIV
	---help---
	  Help message of RTL8188EU for Android4.2
```
